## firmware/sdkconfig.defaults
```kconfig
CONFIG_IDF_TARGET="esp32"
CONFIG_FREERTOS_UNICORE=y
CONFIG_ESP_CONSOLE_NONE=y
CONFIG_BOOTLOADER_WDT_ENABLE=n
CONFIG_ESP_TASK_WDT_EN=n
CONFIG_ESP_INT_WDT=n
```
